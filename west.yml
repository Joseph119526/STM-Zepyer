## west.yml
```yaml
manifest:

  defaults:
    remote: upstream

  remotes:
    - name: upstream
      url-base: https://github.com/zephyrproject-rtos

  projects:
    - name: zephyr
      path: zephyr
      revision: main
      import: false
      west-commands: scripts/west-commands.yml
      
   - name: cmsis
      revision: 512cc7e895e8491696b61f7ba8066b4a182569b8
      path: modules/hal/cmsis
      groups:
        - hal
   - name: cmsis_6
     repo-path: CMSIS_6
     revision: 06d952b6713a2ca41c9224a62075e4059402a151
     path: modules/hal/cmsis_6
    groups:
       - hal

    - name: hal_stm32
      revision: 1e753266ddfb4b07a8a0b1ec566e9637ea45d5ef
      path: modules/hal/stm32
      groups:
        - hal
  self:
    path: app
```
